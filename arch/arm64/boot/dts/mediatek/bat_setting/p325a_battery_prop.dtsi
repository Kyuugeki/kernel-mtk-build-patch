// SPDX-License-Identifier: GPL-2.0+
/*
 * Copyright (c) 2022 MediaTek Inc.
 *
 */

&mtk_gauge {
	DIFFERENCE_FULLOCV_ITH = <(200)>;
/*	Charging termination current*/
	SHUTDOWN_1_TIME = <(30)>;
/*	If ui_soc shows 1% more than X minites, system will shutdown*/
	KEEP_100_PERCENT = <(1)>;
/*	The ui_soc will keep 100% until SOC drop X percents after unplugged*/
	R_FG_VALUE = <(5)>;
/*	R_sense resistance*/
	EMBEDDED_SEL = <(1)>;
/*	Configures whether using embedded battery or not*/
	PMIC_SHUTDOWN_CURRENT = <(20)>;
/*	System shutdown current*/
	FG_METER_RESISTANCE = <(100)>;
/*	The resistance of PCB*/
	CAR_TUNE_VALUE = <(102)>;
/*	Tune value for current measurement*/
	PMIC_MIN_VOL = <(33500)>;
/*	vboot voltage for gauge 0%*/
	POWERON_SYSTEM_IBOOT = <(500)>;
/*	power on system iboot*/
	SHUTDOWN_GAUGE0_VOLTAGE = <(34000)>;
/*	shutdown gauge 0% voltage*/
	TEMPERATURE_T0 = <(50)>;
/*	Battery temperature T0*/
	TEMPERATURE_T1 = <(25)>;
/*	Battery temperature T1*/
	TEMPERATURE_T2 = <(10)>;
/*	Battery temperature T2*/
	TEMPERATURE_T3 = <(0)>;
/*	Battery temperature T3*/
	TEMPERATURE_T4 = <(-10)>;
/*	Battery temperature T4*/
	/* TEMPERATURE_T5 = <(-10)>; */
/*	Battery temperature T5*/
	g_FG_PSEUDO100_T0 = <(97)>;
/*	Pseudo 100% percentage at T0*/
	g_FG_PSEUDO100_T1 = <(97)>;
/*	Pseudo 100% percentage at T1*/
	g_FG_PSEUDO100_T2 = <(97)>;
/*	Pseudo 100% percentage at T2*/
	g_FG_PSEUDO100_T3 = <(97)>;
/*	Pseudo 100% percentage at T3*/
	g_FG_PSEUDO100_T4 = <(97)>;
/*	Pseudo 100% percentage at T4*/
	Q_MAX_SYS_VOLTAGE_BAT0 = <(3350)>;
/*	Pseudo1 for hide percentage*/
	Q_MAX_SYS_VOLTAGE_BAT1 = <(3350)>;
/*	Pseudo1 for hide percentage*/
	Q_MAX_SYS_VOLTAGE_BAT2 = <(3350)>;
/*	Pseudo1 for hide percentage*/
	Q_MAX_SYS_VOLTAGE_BAT3 = <(3350)>;
/*	Pseudo1 for hide percentage*/
	COM_FG_METER_RESISTANCE = <(100)>;
/*	compensate The resistance of PCB*/
	COM_R_FG_VALUE = <(0)>;
/*	compensate R_sense resistance*/
	enable_tmp_intr_suspend = <(0)>;
/* Enable update temp when suspend */
	ACTIVE_TABLE = <(6)>;
/* Table numbers per battery*/
	MULTI_TEMP_GAUGE0 = <(1)>;
/* Multi gauge0 enable*/

/*vboot voltage for gauge 0%*/
g_PMIC_MIN_VOL_row = <4>;
g_PMIC_MIN_VOL_col = <10>;
g_PMIC_MIN_VOL =
<
	34000  34000  33500  34000
	34000  34000  33500  34000
	34000  34000  33500  34000
	32200  32200  33500  33500
	31000  31000  31000  31000
	31500  31500  31500  31500
	31000  31000  31000  31000
	31000  31000  31000  31000
	31000  31000  31000  31000
	31000  31000  31000  31200
>;

/*Pseudo100 percentage setting*/
g_FG_PSEUDO100_row = <4>;
g_FG_PSEUDO100_col = <10>;
g_FG_PSEUDO100 =
<
	98  99  98  95
	98  99  98  95
	98  99  98  95
	98  99  97  95
	100  100  100  100
	100  100  100  100
	100  100  100  100
	100  100  100  100
	100  100  100  100
	100  100  100  100
>;

/* charge_r  pseudo100 setting*/
g_FG_charge_PSEUDO100_row = <4>;
g_FG_charge_PSEUDO100_col = <10>;
g_FG_charge_PSEUDO100 =
<
	100   100  100  100
	100   100  100  100
	100   100  100  100
	100   100  100  100
	100   100  100  100
	100   100  100  100
	100   100  100  100
	100   100  100  100
	100   100  100  100
	100   100  100  100
>;
#include "p325a_battery_table_ext.dtsi"
};


