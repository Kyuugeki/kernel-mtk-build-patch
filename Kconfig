## Kconfig
```kconfig
# SPDX-License-Identifier: GPL-2.0
#
# For a description of the syntax of this configuration file,
# see Documentation/kbuild/kconfig-language.rst.
#
mainmenu "Linux/$(ARCH) $(KERNELVERSION) Kernel Configuration"

source "scripts/Kconfig.include"

source "init/Kconfig"

source "kernel/Kconfig.freezer"

source "fs/Kconfig.binfmt"

source "mm/Kconfig"

source "net/Kconfig"

source "drivers/Kconfig"

source "fs/Kconfig"

source "security/Kconfig"

source "crypto/Kconfig"

source "lib/Kconfig"

source "lib/Kconfig.debug"

source "Documentation/Kconfig"

# TN Begin modified by ruirui.cao/860552 20230729 CR/EKFOGO4G-1376
source "oem/Kconfig"
# TN End modified by ruirui.cao/860552 20230729 CR/EKFOGO4G-1376
```

## drivers/misc/mediatek/sensors-1.0/situation/situation_hub/Kconfig
```kconfig
source "drivers/misc/mediatek/sensors-1.0/situation/situation_hub/stationary/Kconfig"
source "drivers/misc/mediatek/sensors-1.0/situation/situation_hub/inpocket/Kconfig"
source "drivers/misc/mediatek/sensors-1.0/situation/situation_hub/wake_gesture/Kconfig"
source "drivers/misc/mediatek/sensors-1.0/situation/situation_hub/glance_gesture/Kconfig"
source "drivers/misc/mediatek/sensors-1.0/situation/situation_hub/answercall/Kconfig"
source "drivers/misc/mediatek/sensors-1.0/situation/situation_hub/pickup_gesture/Kconfig"
source "drivers/misc/mediatek/sensors-1.0/situation/situation_hub/device_orientation/Kconfig"
source "drivers/misc/mediatek/sensors-1.0/situation/situation_hub/motion_detect/Kconfig"
source "drivers/misc/mediatek/sensors-1.0/situation/situation_hub/tilt_detector/Kconfig"
source "drivers/misc/mediatek/sensors-1.0/situation/situation_hub/flat/Kconfig"
source "drivers/misc/mediatek/sensors-1.0/situation/situation_hub/sar/Kconfig"
#TN Begin modified by ye.yuan/860593 20220825 EKFOGO4G-1638 begin
source "drivers/misc/mediatek/sensors-1.0/situation/situation_hub/flip_twist/Kconfig"
#TN Begin modified by ye.yuan/860593 20220825 EKFOGO4G-1638 end
source "drivers/misc/mediatek/sensors-1.0/situation/situation_hub/chop_chop/Kconfig"
source "drivers/misc/mediatek/sensors-1.0/situation/situation_hub/sig_move/Kconfig"
```

## oem/Kconfig
```kconfig
config OEM_PROJECT
	 bool "Enable oem project config"
	default n
	help
	  enable oem project config.

config PROJECT_P325A
	bool "oem project p325a"
	default n
	help
	  config oem project name.

config FACTORY_BUILD
	bool "oem factory build"
	default n
	help
	  config oem factory build.

config DVT_BUILD
	bool "oem project dvt build"
	default n
	help
	  config oem project dvt build.

config NO_THERMAL_BUILD
	bool "oem project no thermal build"
	default n
	help
	  config oem project no thermal build.

config OEM_DEVINFO
	tristate "oem_devinfo"
	depends on PROJECT_P325A
	default m
	help
	  support oem_devinfo

config OEM_TOUCHSCREEN
	tristate "oem touch"
	depends on PROJECT_P325A
	default m
	help
	  support oem_touch

config SND_SOC_AW87XXX
	tristate "oem smartpa"
	depends on PROJECT_P325A
	default m
	help
	  support oem_smartpa

config OEM_SWITCH_CHARGER_SC89890H
	tristate "oem charger"
	depends on PROJECT_P325A
	default m
	help
	  support oem_charger

config OEM_AW9610X
	tristate "oem sar aw9610x"
	depends on PROJECT_P325A
	default m
	help
	  support oem_aw9610x

config OEM_ANT_DET
	tristate "oem antdet"
	depends on PROJECT_P325A
	default m
	help
	  support oem_antdet

config OEM_FINGERPRINT
	tristate "oem fingerprint"
	depends on PROJECT_P325A
	default m
	help
	  support oem_fingerprint

config OEM_TCPC_PD_SC2150A
	tristate "oem tcpc pd sc2150a"
	depends on PROJECT_P325A
	default m
	help
	  support oem_tcpc_pd_sc2150a

config OEM_TCPC_AW35616
	tristate "oem tcpc aw35616"
	depends on PROJECT_P325A
	default m
	help
	  support oem_tcpc_aw35616

config OEM_CHARGER_PUMP_SC8541
	tristate "oem charger pump sc8541"
	depends on PROJECT_P325A
	default m
	help
	  support oem_charger_pump_sc8541

config OEM_SWITCH_CHARGER_SGM41542
	tristate "oem switch charger sgm41542"
	depends on PROJECT_P325A
	default m
	help
	  support oem_switch_charger_sgm41542

config OEM_TCPC_HUSB320
	tristate "oem tcpc husb320"
	depends on PROJECT_P325A
	default m
	help
	  support oem_tcpc_husb320

config OEM_CHARGER_LED
	tristate "oem charger led"
	depends on PROJECT_P325A
	default m
	help
	  support charger led

config OEM_TCPC_PD_AW35615
	tristate "oem tcpc pd aw35615"
	depends on PROJECT_P325A
	default m
	help
	  support oem_tcpc_pd_aw35615

config OEM_CHARGER_PUMP_NU2115
	tristate "oem charger pump nu2115"
	depends on PROJECT_P325A
	default m
	help
	  support oem_charger_pump_nu2115

config NXP_NFC_I2C
	tristate "oem nxp pn560uk"
	depends on PROJECT_P325A
	default m
	help
	  support oem_nxp_pn560uk

config OEM_TURBO_CHARGER
	tristate "oem turbo charger"
	depends on PROJECT_P325A
	default m
	help
	  support oem_turbo_charger

config OEM_QC_LOGIC_Z350
	tristate "oem qc logic z350"
	depends on PROJECT_P325A
	default m
	help
	  support oem_qc_logic_z350

config OEM_TINNO_CHARGER
	tristate "oem tinno charger"
	depends on PROJECT_P325A
	default n
	help
	  support oem_tinno_charger

config OEM_DEVINFO
	tristate "oem devinfo"
	depends on PROJECT_P325A
	default n
	help
	  support oem_devinfos

config OEM_CHARGER_PUMP
	tristate "oem charger pump"
	depends on PROJECT_P325A
	default n
	help
	  support oem_charger_pump
```
